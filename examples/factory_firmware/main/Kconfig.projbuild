## examples/factory_firmware/main/Kconfig.projbuild
```kconfig
menu "Factory Firmware Example Configuration"
    config VOICE_ID
        string "Speaker Id"
        default "qiumum_0gushi"
        help
            speaker id from https://czyt.tech/post/a-free-tts-api/?from_wecom=1
    config VOLUME_LEVEL
        int "volume level"
        default "90"
        range 1 100
        help
            speaker volume
    config ENABLE_FACTORY_FW_DEBUG_LOG
        bool "Enable debug log level for this example project"
        default "n"
        help
            Enable debug log level for this factory firmware example project

    config SKIP_COMMON_NAME_CHECK
        bool "Skip server certificate Common Name field check"
        default n
        help
            This allows you to skip the validation of OTA server certificate CommonName field. But please don't enable this if the cert of your OTA server needs SNI support.

    config ENABLE_TASKFLOW_FROM_SPIFFS
        bool "Enable start taskflow from spiffs file"
        default n
        help
            Enable start taskflow from spiffs file default file name is taskflow.json

    config ENABLE_TEST_ENV
        bool "Test Env"
        default n
        help
            In test env, connects to test servers, enable test code snippets.

    config INTR_TRACKING
        bool "intr tracking"
        default n
        help
            Enable intr tarcking.

    config CAMERA_DISPLAY_MIRROR_X
        bool "camera display mirror x"
        default y
        help
            Enable camera display mirror x.
    config ENABLE_VI_SR
        bool "Enable wake-up word and VAD detection (experimental feature)"
        default n
        help
            Enable wake-up word and VAD detection functions, SR is still an experimental feature .

    config GPTNIX_WATCHER_VOICE
        bool "Enable GPTNiX Watcher realtime voice transport foundation"
        default n

    config GPTNIX_WATCHER_PROVISION
        bool "Enable GPTNiX Watcher M3A host provisioning canary"
        depends on GPTNIX_WATCHER_VOICE
        default n
        help
            Enables the M3A host-controlled provisioning canary: a pre-REPL raw
            UART handoff that stages a short-lived Firebase device ID token in
            RAM only (never NVS), waits for an explicit host commit, then calls
            the GPTNiX backend session endpoint and hands the response to the
            existing M2 voice transport. Diagnostic transport-only canary -- no
            microphone/speaker streaming. Requires a controlled,
            developer-attended provisioning session; not a production
            onboarding flow.

    config GPTNIX_WATCHER_SESSION_URL
        string "GPTNiX Watcher V2 realtime session HTTPS URL"
        depends on GPTNIX_WATCHER_PROVISION
        default ""
        help
            Non-secret HTTPS URL of the GPTNiX backend's
            /v2/watcher/realtime/session endpoint. Must start with https:// and
            end with the canonical path /v2/watcher/realtime/session. Carries
            no credential of its own -- the bearer token is supplied
            separately at runtime via the M3A provisioning handoff, never
            embedded in this URL or in firmware source.

    config GPTNIX_WATCHER_VOICE_RUNTIME
        bool "Enable GPTNiX Watcher M3C runtime audio bridge (mic/speaker <-> Gemini Live)"
        depends on GPTNIX_WATCHER_PROVISION
        default n
        help
            Enables the M3C runtime audio bridge: once the M3A provisioning
            sequence reaches a READY Gemini Live WS session, keeps that
            session alive (instead of the M3A diagnostic canary's
            connect-then-disconnect behavior) and starts streaming captured
            microphone audio to Gemini while forwarding Gemini's spoken
            response to the speaker. This is the first milestone that
            actually plays audio through the device -- disabled by default,
            separate from the M3A diagnostic canary path so M3A's existing
            proven provisioning behavior is unaffected when this is off.

    config GPTNIX_WATCHER_VOICE_SYNTHETIC_TEST_AUDIO
        bool "M3C: feed a canned SPIFFS PCM clip instead of live microphone capture (autonomous testing only)"
        depends on GPTNIX_WATCHER_VOICE_RUNTIME
        default n
        help
            Diagnostic-only mode (plans/M3C_AUDIO_BRIDGE_CHILD_TASK.md follow-up) letting round-trip
            latency/quality testing happen without a human physically present to speak. When enabled, the
            capture task reads /spiffs/gptnix_synth_test.pcm (16kHz/16-bit/mono raw PCM, no WAV header)
            in real-time-paced chunks INSTEAD OF calling any app_audio_recorder_* API, feeding the exact
            same downstream local-ring-buffer -> WS-send pipeline a live microphone capture would. Never
            touches microphone hardware in this mode. Default n -- this is a lab/test aid, not a shipped
            feature; the speaker/playback path is completely unaffected either way.
endmenu
```
